#include <Wire.h>
#include "MAX30100_PulseOximeter.h"

#include <SPI.h>
#include <Adafruit_GFX.h>
#include <Adafruit_PCD8544.h>

// Software SPI (slower updates, more flexible pin options):
// pin 7 - Serial clock out (SCLK)
// pin 6 - Serial data out (DIN)
// pin 5 - Data/Command select (D/C)
// pin 4 - LCD chip select (CS)
// pin 3 - LCD reset (RST)
Adafruit_PCD8544 display = Adafruit_PCD8544(8, 9, 10, 11, 12);

// Hardware SPI (faster, but must use certain hardware pins):
// SCK is LCD serial clock (SCLK) - this is pin 13 on Arduino Uno
// MOSI is LCD DIN - this is pin 11 on an Arduino Uno
// pin 5 - Data/Command select (D/C)
// pin 4 - LCD chip select (CS)
// pin 3 - LCD reset (RST)
// Adafruit_PCD8544 display = Adafruit_PCD8544(5, 4, 3);
// Note with hardware SPI MISO and SS pins aren't used but will still be read
// and written to during SPI transfer.  Be careful sharing these pins!

 
#define REPORTING_PERIOD_MS     1000
 
PulseOximeter pox;
uint32_t tsLastReport = 0;



static const unsigned char PROGMEM logo16_glcd_bmp[] = 
{
 0x00, 0x00, 0x00, 0x00, 0x00, 0x00, 0x00, 0x00, 0x00, 0x00, 0x00, 0x00, 0x00, 0x00, 0x00, 0x00, 
  0x00, 0x00, 0x00, 0x00, 0x00, 0x00, 0x00, 0x00, 0x00, 0x00, 0x00, 0x00, 0x00, 0x00, 0x00, 0x00, 
  0x00, 0x00, 0x00, 0x00, 0x00, 0x00, 0x00, 0x00, 0x00, 0x00, 0x00, 0x00, 0x00, 0x01, 0xff, 0x00, 
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  0x00, 0x00, 0x00, 0x00, 0x00, 0x00, 0x00, 0x00, 0x00, 0x00, 0x00, 0x00, 0x00, 0x00, 0x00, 0x00
};



void onBeatDetected()
{
    Serial.println("Beat!");
}
 
void setup()
{
    Serial.begin(115200);
    Serial.print("Initializing pulse oximeter..");

    display.begin();
  // init done

  // you can change the contrast around to adapt the display
  // for the best viewing!
    display.setContrast(40);
    // text display tests
    display.setTextSize(1);
    display.setRotation(2);  // rotate 90 degrees counter clockwise, can also use values of 2 and 3 to go further.
    display.setTextColor(BLACK);

    // logo bitmap display
    display.clearDisplay();
    display.drawBitmap(0, 0,  logo16_glcd_bmp, 84, 48, BLACK);
    display.display();
    delay(2000);
    display.clearDisplay();

 
    // Initialize the PulseOximeter instance
    // Failures are generally due to an improper I2C wiring, missing power supply
    // or wrong target chip
    if (!pox.begin()) {
        Serial.println("FAILED");
        for(;;);
    } else {
        Serial.println("SUCCESS");
    }
     pox.setIRLedCurrent(MAX30100_LED_CURR_7_6MA);
 
    // Register a callback for the beat detection
    pox.setOnBeatDetectedCallback(onBeatDetected);
}
 
void loop()
{
    // Make sure to call update as fast as possible
    pox.update();
    if (millis() - tsLastReport > REPORTING_PERIOD_MS) {
        Serial.print("Heart rate:");
        Serial.print(pox.getHeartRate());
        Serial.print("bpm / SpO2:");
        Serial.print(pox.getSpO2());
        Serial.println("%");

        display.setCursor(10,0);
        display.println("ROBOTRONIOCS");

        display.setCursor(0,10);
        display.println("Pulse Oximeter");
        
        display.setCursor(0,30);
        display.println("PR   : ");
        display.setCursor(40,30);
        display.println(round(pox.getHeartRate()));
        display.setCursor(60,30);
        display.println("bpm");
        
        display.setCursor(0,40);        
        display.println("SpO2 : ");
        display.setCursor(40,40);
        display.println(pox.getSpO2());
        display.setCursor(60,40);
        display.println("%");
        display.display();
        display.clearDisplay();
 
        tsLastReport = millis();
    }
}
